## Kconfig
```kconfig
mainmenu "Micro DOOM"

menu "Zephyr"
source "Kconfig.zephyr"
endmenu

menu "Micro DOOM"

config DOOM_NO_COMPACT_PTR
	bool "No compact pointers"
	default n if BOARD_RPI_PICO
	help
		Disables or enables *_sptr variables throughout the codebase for different
		members of structs, args in function calls... Reduces code size at the expense
		of performance. Will be forcefully enabled for some targets that cannot have
		compact pointers due to memory mappings.

config DOOM_FORCE_NO_COMPACT_PTR_BOARDS
	bool
	default y if BOARD_NATIVE_SIM || BOARD_ESP32_DEVKITC || BOARD_ESP32S3_DEVKITC || BOARD_ESP32P4_FUNCTION_EV_BOARD
	help
		Internal variable for defining boards where DOOM_NO_COMPACT_PTR should be forced.

config FORCE_DOOM_NO_COMPACT_PTR
	bool
	default y if DOOM_FORCE_NO_COMPACT_PTR_BOARDS
	select DOOM_NO_COMPACT_PTR
	depends on DOOM_FORCE_NO_COMPACT_PTR_BOARDS
	help
		Internal option that forces DOOM_NO_COMPACT_PTR to be enabled for selected targets.

config DOOM_DISPLAY_PADDING
	bool "Pad display for uneven height"
	default y if BOARD_RPI_PICO || BOARD_ESP32_DEVKITC || BOARD_ESP32S3_DEVKITC
	help
		Draw a black padding row (squish the screen) if the height of the display is uneven.
		Reduces drawing latency by only needing to draw two half blocks of the dispaly, 
		rather than half block + half line + half line + half block.

config DOOM_ALLOCATOR_MAX_STATIC_ZONE_SIZE
	int "Max size of the allocator mem pool"
	default 80000 if BOARD_ESP32_DEVKITC
	default 113600 # from base code
	help
		Define the maximum size of the staticZone[] mem pool for DOOM's allocator.
		Originally is set to 113600 bytes, but this may be lowered depending on build target due to RAM limitations.

config DOOM_CACHE_IN_PSRAM
	bool "Keep the lump cache in PSRAM instead of flash"
	depends on ESP_SPIRAM
	help
		Serve the cache partition (level/immutable lump cache) from a PSRAM
		buffer instead of the external flash. The game keeps using the same
		cache-partition addresses; only the flash layer changes. Removes the
		word-by-word flash writes and sector erases on every level change.
		PSRAM is volatile, so the cache is rebuilt at every boot (which the
		game already does).

config DOOM_GAME_THREAD_STACK_SIZE
	int "Game thread stack size"
	default 65536 if BOARD_ESP32P4_FUNCTION_EV_BOARD || BOARD_NATIVE_SIM
	default 10240
	help
		Stack size of the game thread. The ESP32-P4 (RISC-V) needs extra headroom
		for the render recursion; the RAM-constrained targets keep the original 10KB.

endmenu
```
