## Kconfig
```kconfig
mainmenu "Micro DOOM"

menu "Zephyr"
source "Kconfig.zephyr"
endmenu

menu "Micro DOOM"

config DOOM_NO_COMPACT_PTR
	bool "No compact pointers"
	default n if BOARD_RPI_PICO
	help
		Disables or enables *_sptr variables throughout the codebase for different
		members of structs, args in function calls... Reduces code size at the expense
		of performance. Will be forcefully enabled for some targets that cannot have
		compact pointers due to memory mappings.

config DOOM_FORCE_NO_COMPACT_PTR_BOARDS
	bool
	default y if BOARD_NATIVE_SIM || BOARD_ESP32_DEVKITC_WROOM
	help
		Internal variable for defining boards where DOOM_NO_COMPACT_PTR should be forced.

config FORCE_DOOM_NO_COMPACT_PTR
	bool
	default y if DOOM_FORCE_NO_COMPACT_PTR_BOARDS
	select DOOM_NO_COMPACT_PTR
	depends on DOOM_FORCE_NO_COMPACT_PTR_BOARDS
	help
		Internal option that forces DOOM_NO_COMPACT_PTR to be enabled for selected targets.

config DOOM_DISPLAY_PADDING
	bool "Pad display for uneven height"
	default y if BOARD_RPI_PICO || BOARD_ESP32_DEVKITC_WROOM
	help
		Draw a black padding row (squish the screen) if the height of the display is uneven.
		Reduces drawing latency by only needing to draw two half blocks of the dispaly, 
		rather than half block + half line + half line + half block.

config DOOM_ALLOCATOR_MAX_STATIC_ZONE_SIZE
	int "Max size of the allocator mem pool"
	default 80000 if BOARD_ESP32_DEVKITC_WROOM
	default 113600 # from base code
	help
		Define the maximum size of the staticZone[] mem pool for DOOM's allocator.
		Originally is set to 113600 bytes, but this may be lowered depending on build target due to RAM limitations.

endmenu
```

## boards/esp32s3_devkitc_dongle.conf
```kconfig
CONFIG_LEGACY_GENERATED_INCLUDE_PATH=n

CONFIG_MAIN_STACK_SIZE=2048

CONFIG_LOG=y
CONFIG_LOG_MODE_MINIMAL=y
CONFIG_PRINTK=y
CONFIG_SERIAL=y
CONFIG_CONSOLE=y
CONFIG_STDOUT_CONSOLE=y
CONFIG_EARLY_CONSOLE=y
CONFIG_UART_CONSOLE=y

CONFIG_DISPLAY=y
CONFIG_ST7735R=y
# CONFIG_ST7735R_BGR565=y

CONFIG_GPIO=y
CONFIG_PINCTRL=y
CONFIG_PINCTRL_ESP32=y

CONFIG_SPI=y
# CONFIG_SPI_ASYNC is not set
CONFIG_ESP32_SPIM=y
# CONFIG_SPI_ESP32_INTERRUPT is not set

# CONFIG_DMA is not set

CONFIG_ESPTOOLPY_FLASHMODE_QIO=y
CONFIG_ESPTOOLPY_FLASHFREQ_80M=y

CONFIG_FLASH=y
CONFIG_FLASH_MAP=y
CONFIG_XIP=y
CONFIG_MPU_ALLOW_FLASH_WRITE=y
CONFIG_CACHE=y

CONFIG_ESPTOOLPY_HEADER_FLASHSIZE_UPDATE=y
CONFIG_ESPTOOLPY_FLASHSIZE_16MB=y

CONFIG_POSIX_TIMERS=y
CONFIG_POSIX_MONOTONIC_CLOCK=y
CONFIG_POSIX_CLOCK_SELECTION=y

CONFIG_DEBUG=y
CONFIG_DEBUG_INFO=y
CONFIG_DEBUG_THREAD_INFO=y
CONFIG_DEBUG_OPTIMIZATIONS=y
# CONFIG_DEBUG_COREDUMP is not set
CONFIG_SERIAL_ESP32_USB=y
CONFIG_UART_CONSOLE_DEBUG_SERVER_HOOKS=y
```

## boards/esp32s3_devkitc_nodongle.conf
```kconfig
CONFIG_LEGACY_GENERATED_INCLUDE_PATH=n

CONFIG_MAIN_STACK_SIZE=2048

CONFIG_LOG=y
CONFIG_LOG_MODE_MINIMAL=y
CONFIG_PRINTK=y
CONFIG_CONSOLE=y
CONFIG_STDOUT_CONSOLE=y
CONFIG_EARLY_CONSOLE=y

CONFIG_DISPLAY=y
CONFIG_ST7789V=y

CONFIG_GPIO=y
CONFIG_PINCTRL=y
CONFIG_PINCTRL_ESP32=y

# PWM Support for backlight control
CONFIG_PWM=y
CONFIG_PWM_LED_ESP32=y

# CONFIG_SPI is not set
# CONFIG_SPI_ASYNC is not set
# CONFIG_ESP32_SPIM is not set
# CONFIG_SPI_ESP32_INTERRUPT is not set

# CONFIG_BOOT_BANNER is not set
# CONFIG_SPI_FLASH_SUPPORT_ISSI_CHIP is not set
# CONFIG_SPI_FLASH_SUPPORT_MXIC_CHIP is not set
# CONFIG_SPI_FLASH_SUPPORT_GD_CHIP is not set
CONFIG_SPI_FLASH_SUPPORT_WINBOND_CHIP=y
# CONFIG_SPI_FLASH_SUPPORT_BOYA_CHIP is not set
# CONFIG_SPI_FLASH_SUPPORT_TH_CHIP is not set
# CONFIG_SPI_FLASH_SUPPORT_MXIC_OPI_CHIP is not set
# CONFIG_SPI_FLASH_ROM_DRIVER_PATCH is not set

CONFIG_DMA=y
CONFIG_DMA_ESP32_MAX_DESCRIPTOR_NUM=128

CONFIG_ESPTOOLPY_FLASHMODE_QIO=y
CONFIG_ESPTOOLPY_FLASHFREQ_80M=y

CONFIG_FLASH=y
CONFIG_FLASH_MAP=y
CONFIG_XIP=y
CONFIG_MPU_ALLOW_FLASH_WRITE=y
CONFIG_CACHE=y

CONFIG_ESPTOOLPY_HEADER_FLASHSIZE_UPDATE=y
CONFIG_ESPTOOLPY_FLASHSIZE_16MB=y

CONFIG_POSIX_THREADS=y
CONFIG_POSIX_SYSTEM_INTERFACES=y

CONFIG_DEBUG=y
CONFIG_DEBUG_THREAD_INFO=y
CONFIG_DEBUG_OPTIMIZATIONS=y
# CONFIG_DEBUG_COREDUMP is not set

# Enable debug logging for MIPI DBI driver
CONFIG_MIPI_DBI_LOG_LEVEL_DBG=y
CONFIG_LOG_MAX_LEVEL=4
```

## boards/native_sim.conf
```kconfig
CONFIG_DEBUG=y
CONFIG_DEBUG_INFO=y
CONFIG_DEBUG_OPTIMIZATIONS=y
CONFIG_DEBUG_THREAD_INFO=y
CONFIG_FRAME_POINTER=y

CONFIG_OUTPUT_PRINT_MEMORY_USAGE=y
CONFIG_FLASH=y
CONFIG_FLASH_MAP=y

CONFIG_GPIO=y
CONFIG_GPIO_EMUL=y
CONFIG_GPIO_EMUL_SDL=y

CONFIG_LOG=y
CONFIG_LOG_MODE_MINIMAL=y
CONFIG_PRINTK=y
CONFIG_CONSOLE=y
CONFIG_STDOUT_CONSOLE=y
CONFIG_EARLY_CONSOLE=y

CONFIG_ARCH_POSIX_TRAP_ON_FATAL=y

CONFIG_POSIX_TIMERS=y
CONFIG_POSIX_MONOTONIC_CLOCK=y
CONFIG_POSIX_CLOCK_SELECTION=y
CONFIG_POSIX_THREAD_CPUTIME=y

CONFIG_DISPLAY=y

CONFIG_SDL_DISPLAY=y
CONFIG_SDL_DISPLAY_USE_HARDWARE_ACCELERATOR=n
CONFIG_SDL_DISPLAY_ZOOM_PCT=300
CONFIG_SDL_DISPLAY_DEFAULT_PIXEL_FORMAT_BGR_565=y

CONFIG_BOOT_BANNER=n
CONFIG_MINIMAL_LIBC=y
```

## build/Kconfig/Kconfig.modules
```kconfig
menu "canopennode (/home/gez/sdks/zephyr/modules/lib/canopennode)"
osource "$(ZEPHYR_CANOPENNODE_KCONFIG)"
config ZEPHYR_CANOPENNODE_MODULE
	bool
	default y
endmenu
menu "chre (/home/gez/sdks/zephyr/modules/lib/chre)"
osource "/home/gez/sdks/zephyr/modules/lib/chre/platform/zephyr/Kconfig"
config ZEPHYR_CHRE_MODULE
	bool
	default y
endmenu
menu "fatfs (/home/gez/sdks/zephyr/modules/fs/fatfs)"
osource "$(ZEPHYR_FATFS_KCONFIG)"
config ZEPHYR_FATFS_MODULE
	bool
	default y
endmenu
menu "hal_espressif (/home/gez/sdks/zephyr/modules/hal/espressif)"
osource "/home/gez/sdks/zephyr/modules/hal/espressif/zephyr/Kconfig"
config ZEPHYR_HAL_ESPRESSIF_MODULE
	bool
	default y
	select TAINT_BLOBS
endmenu
menu "hal_ethos_u (/home/gez/sdks/zephyr/modules/hal/ethos_u)"
osource "$(ZEPHYR_HAL_ETHOS_U_KCONFIG)"
config ZEPHYR_HAL_ETHOS_U_MODULE
	bool
	default y
endmenu
menu "hal_gigadevice (/home/gez/sdks/zephyr/modules/hal/gigadevice)"
osource "$(ZEPHYR_HAL_GIGADEVICE_KCONFIG)"
config ZEPHYR_HAL_GIGADEVICE_MODULE
	bool
	default y
endmenu
menu "hal_infineon (/home/gez/sdks/zephyr/modules/hal/infineon)"
osource "$(ZEPHYR_HAL_INFINEON_KCONFIG)"
config ZEPHYR_HAL_INFINEON_MODULE
	bool
	default y
endmenu
menu "hal_nordic (/home/gez/sdks/zephyr/modules/hal/nordic)"
osource "$(ZEPHYR_HAL_NORDIC_KCONFIG)"
config ZEPHYR_HAL_NORDIC_MODULE
	bool
	default y
endmenu
menu "hal_nxp (/home/gez/sdks/zephyr/modules/hal/nxp)"
osource "$(ZEPHYR_HAL_NXP_KCONFIG)"
config ZEPHYR_HAL_NXP_MODULE
	bool
	default y
endmenu
menu "hal_rpi_pico (/home/gez/sdks/zephyr/modules/hal/rpi_pico)"
osource "$(ZEPHYR_HAL_RPI_PICO_KCONFIG)"
config ZEPHYR_HAL_RPI_PICO_MODULE
	bool
	default y
endmenu
menu "silabs (/home/gez/sdks/zephyr/modules/hal/silabs)"
osource "/home/gez/sdks/zephyr/modules/hal/silabs/zephyr/Kconfig"
config ZEPHYR_SILABS_MODULE
	bool
	default y
endmenu
menu "hal_telink (/home/gez/sdks/zephyr/modules/hal/telink)"
osource "/home/gez/sdks/zephyr/modules/hal/telink/Kconfig"
config ZEPHYR_HAL_TELINK_MODULE
	bool
	default y
endmenu
menu "liblc3 (/home/gez/sdks/zephyr/modules/lib/liblc3)"
osource "$(ZEPHYR_LIBLC3_KCONFIG)"
config ZEPHYR_LIBLC3_MODULE
	bool
	default y
endmenu
menu "littlefs (/home/gez/sdks/zephyr/modules/fs/littlefs)"
osource "$(ZEPHYR_LITTLEFS_KCONFIG)"
config ZEPHYR_LITTLEFS_MODULE
	bool
	default y
endmenu
menu "loramac-node (/home/gez/sdks/zephyr/modules/lib/loramac-node)"
osource "$(ZEPHYR_LORAMAC_NODE_KCONFIG)"
config ZEPHYR_LORAMAC_NODE_MODULE
	bool
	default y
endmenu
menu "lvgl (/home/gez/sdks/zephyr/modules/lib/gui/lvgl)"
osource "/home/gez/sdks/zephyr/modules/lib/gui/lvgl/zephyr/Kconfig"
config ZEPHYR_LVGL_MODULE
	bool
	default y
endmenu
menu "lz4 (/home/gez/sdks/zephyr/modules/lib/lz4)"
osource "$(ZEPHYR_LZ4_KCONFIG)"
config ZEPHYR_LZ4_MODULE
	bool
	default y
endmenu
menu "mbedtls (/home/gez/sdks/zephyr/modules/crypto/mbedtls)"
osource "$(ZEPHYR_MBEDTLS_KCONFIG)"
config ZEPHYR_MBEDTLS_MODULE
	bool
	default y
endmenu
menu "nanopb (/home/gez/sdks/zephyr/modules/lib/nanopb)"
osource "$(ZEPHYR_NANOPB_KCONFIG)"
config ZEPHYR_NANOPB_MODULE
	bool
	default y
endmenu
menu "openthread (/home/gez/sdks/zephyr/modules/lib/openthread)"
osource "$(ZEPHYR_OPENTHREAD_KCONFIG)"
config ZEPHYR_OPENTHREAD_MODULE
	bool
	default y
endmenu
menu "picolibc (/home/gez/sdks/zephyr/modules/lib/picolibc)"
osource "/home/gez/sdks/zephyr/modules/lib/picolibc/zephyr/Kconfig"
config ZEPHYR_PICOLIBC_MODULE
	bool
	default y
endmenu
menu "segger (/home/gez/sdks/zephyr/modules/debug/segger)"
osource "$(ZEPHYR_SEGGER_KCONFIG)"
config ZEPHYR_SEGGER_MODULE
	bool
	default y
endmenu
menu "sof (/home/gez/sdks/zephyr/modules/audio/sof)"
osource "/home/gez/sdks/zephyr/modules/audio/sof/zephyr/Kconfig"
config ZEPHYR_SOF_MODULE
	bool
	default y
endmenu
menu "tflite-micro (/home/gez/sdks/zephyr/modules/lib/tflite-micro)"
osource "$(ZEPHYR_TFLITE_MICRO_KCONFIG)"
config ZEPHYR_TFLITE_MICRO_MODULE
	bool
	default y
endmenu
menu "TraceRecorder (/home/gez/sdks/zephyr/modules/debug/TraceRecorder)"
osource "/home/gez/sdks/zephyr/modules/debug/TraceRecorder/kernelports/Zephyr/Kconfig"
config ZEPHYR_TRACERECORDER_MODULE
	bool
	default y
endmenu
menu "trusted-firmware-m (/home/gez/sdks/zephyr/modules/tee/tf-m/trusted-firmware-m)"
osource "$(ZEPHYR_TRUSTED_FIRMWARE_M_KCONFIG)"
config ZEPHYR_TRUSTED_FIRMWARE_M_MODULE
	bool
	default y
endmenu
menu "trusted-firmware-a (/home/gez/sdks/zephyr/modules/tee/tf-a/trusted-firmware-a)"
osource "$(ZEPHYR_TRUSTED_FIRMWARE_A_KCONFIG)"
config ZEPHYR_TRUSTED_FIRMWARE_A_MODULE
	bool
	default y
endmenu
menu "uoscore-uedhoc (/home/gez/sdks/zephyr/modules/lib/uoscore-uedhoc)"
osource "$(ZEPHYR_UOSCORE_UEDHOC_KCONFIG)"
config ZEPHYR_UOSCORE_UEDHOC_MODULE
	bool
	default y
endmenu
menu "zcbor (/home/gez/sdks/zephyr/modules/lib/zcbor)"
osource "$(ZEPHYR_ZCBOR_KCONFIG)"
config ZEPHYR_ZCBOR_MODULE
	bool
	default y
endmenu
menu "zscilib (/home/gez/sdks/zephyr/modules/lib/zscilib)"
osource "/home/gez/sdks/zephyr/modules/lib/zscilib/Kconfig.zscilib"
config ZEPHYR_ZSCILIB_MODULE
	bool
	default y
endmenu
menu "thrift (/home/gez/sdks/zephyr/modules/lib/thrift)"
osource "$(ZEPHYR_THRIFT_KCONFIG)"
config ZEPHYR_THRIFT_MODULE
	bool
	default y
endmenu
```
